

void ch_fA()
     {
         color_a=0.0;
         color_b=0.0;
         color_c=0.0;
         color_d=0.0;
         color_c=0.0;
         color_e=0.0;
  
//////////////////////////////////////////////////////  เดินจากจุดสตาร์ท ไปเก็บกล่องสี แล้วเดินจนถึงพื้นสีที่ 1

   fline (20 ,20,5,10, 'g',2 ); BZ(30);servo_kang() ;S_down() ;
   fline (15 ,15,5,30,2 );
   fline (6  ,6 , 5, 10, 'f',15 ); BZ(30);servo_small();
   fline (20 ,20,5, 10, 'f','l',5 ); BZ(30);
   fline (20 ,20,5, 10, 'f','l',5 ); BZ(30);
   fline (20 ,20,5, 10, 'f','r',15 ); BZ(30);
   fline (8 ,8,12, 10, 'c',15 ); BZ(30);


///////////////////////////////////////////////////////////เก็บค่าสีพื้น ที่ 1 ถ้ากรอบอยู่ข้างซ้าย ให้เลือก spi_color_l_a ();  ถ้ากรอบอยู่ข้างซ้าย ให้เลือก spi_color_r_a (); 

                       /////////เก็บค่าในรูปตัวแปล color_a  ซึ่งจะเป็นอะไรก็ได้ ตั้งแต่ 1234567
     //  spi_color_l_a ();
         spi_color_r_a (); 
                      
  //       sw();



////////////////////////////////////////////////////////////////เช็คสีกล่อง กับสีพื้น
       
       ch_color_box();
  
       ch_color_floor_spi_r();
       
  
       if  (color_spi_r == color_box)
            {

             do{ read_sensor_F(); Motor(20,0); } while(A0>200);
             do{ Motor(20,-20); } while(digitalRead(PA10)==1); delay(80); Motor(-30,-10,4); Motor(0,0,5); BZ(30); servo_kang(); delay(100); S_UP();
             
             do{ read_sensor_F(); Motor(-20,15); } while(A4>80);   BZ(30);    
                  
          

            }
            
       else 
            {
               
               
            }
       

//////////////////////////////////////////////////////////// เดินไปสีพื้นที่ 2

   
  colorline (20 ,20, 5, 'r','l', 10);  BZ(30);
  fline (20 ,20,5, 10, 'f','r',10 ); BZ(30);
  fline (8 ,8,5, 10, 'c',15 ); BZ(30);


   
     

 //  sw();


 ///////////////////////////////////////////////////////////เก็บค่าสีพื้น ที่ 2 ถ้ากรอบอยู่ข้างซ้าย ให้เลือก spi_color_l_a ();  ถ้ากรอบอยู่ข้างซ้าย ให้เลือก spi_color_r_a (); 

        spi_color_r_b ();    BZ(30);BZ(30);              /////////เก็บค่าในรูปตัวแปล color_b  ซึ่งจะเป็นอะไรก็ได้ ตั้งแต่ 1234567
  ///   spi_color_l_b ();    BZ(30);BZ(30); 

        

////////////////////////////////////////////////////////////////เช็คสีกล่อง กับสีพื้น พื้นสีที่ 2
       ch_color_box();  
       ch_color_floor_spi_r();
       
  
       if  (color_spi_r == color_box)       /////////////////////////วางกล่องแล้วเดินไปถึงแยกก่อนเข้าคีบกล่องที่ 2
            {

             do{ read_sensor_F(); Motor(20,0); } while(A0>200);
             do{  Motor(20,-20); } while(digitalRead(PA10)==1); delay(80);Motor(-30,-10,4); Motor(0,0,5); BZ(30); servo_kang(); delay(100); S_UP();
             
             do{ read_sensor_F(); Motor(-20,15); } while(A4>80);   BZ(30);    
             bline (20 ,20,5, 10, 'c','l',8 ); BZ(30);                    
                                      
                    
          

            }
            
       else if (color_box == 7)    /////////////////////////////////เดินไปกล่อง 2 เดินไปข้ามแยกก่อนเข้าคีบกล่องที่ 2  
            {            
                                               

                 bline (20 ,20,5, 10, 'c','l',8 ); BZ(30);                    
                 servo_kang() ;S_down() ;                           
                
                              
              
                    
                       
            }
                   
        else            ///////////////////////////////////////////////ถ้ามีกล่อง  ให้เดินไปพื้นที่ 3  วางกล่องที่พื้นที่ 3  แล้วเดินที่ที่กล่องที่ 2 ก่อนถึงกล่องที่ 2 ให้เข้าทางเดียวกันกับ ตอนเช็คพื้นที่ 2
                                                                  
            {
                colorline (20 ,20, 5, 'r','l', 10);  BZ(30);
                fline (15 ,15,10, 10, 'c',10 ); BZ(30);       
                do{ read_sensor_F(); Motor(20,0); } while(A0>200);
                do{  Motor(20,0); } while(digitalRead(PA10)==1); delay(80);Motor(-30,-10,4); Motor(0,0,5); BZ(30); servo_kang(); delay(100); S_UP();
             
                do{ read_sensor_F(); Motor(-20,0); } while(A4>80);   BZ(30);                       
                bline (20 ,20,10, 10, 'c','l',10 ); BZ(30);
                colorline (20 ,20, 5, 'l','c', 2);  BZ(30); 
                fline (20 ,20,10, 10, 'f','r',10 ); BZ(30);                                             
                     
                                  
            }   

                        
 
}
